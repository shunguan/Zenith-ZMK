/*
 * Copyright (c) 2026 The ZMK Contributors
 *
 * SPDX-License-Identifier: MIT
 */

/*
 * Extend the XIAO connector nexus past D10.
 *
 * This repo vendors its own seeeduino_xiao_ble board whose
 * seeed_xiao_connector.dtsi maps indices 0..19 -- the standard D0-D10 plus nine
 * entries for the XIAO BLE's extra pads. Zenith's halves use three of those
 * extras for matrix columns (&xiao_d 17, 18, 19).
 *
 * On ZMK main the vendored board is not used at all: it is in the old hardware
 * model v1 layout, which Zephyr 4.1 ignores, so xiao_d comes from Zephyr's own
 * xiao_ble board -- and that one stops at <10 0 &gpio1 15 0>. Indices 11..19
 * then do not exist and the halves fail to build, while the dongle is unaffected
 * because it deletes kscan0 and never names a column pin.
 *
 * gpio-map is a single property, so it cannot be appended to: the whole map is
 * restated here. Indices 0..10 are byte-identical to Zephyr's; 11..19 are copied
 * from the vendored board so the pin numbering the overlays already use is
 * preserved exactly.
 *
 * Note for future use: indices 14 and 15 are P0.09 and P0.10, which are the
 * nRF52840's NFC pins and need CONFIG_NFCT_PINS_AS_GPIO=y before they work as
 * GPIO. Zenith does not use them, so nothing here depends on that.
 */

&xiao_d {
    gpio-map
        = <0 0 &gpio0 2 0>          /* D0 */
        , <1 0 &gpio0 3 0>          /* D1 */
        , <2 0 &gpio0 28 0>         /* D2 */
        , <3 0 &gpio0 29 0>         /* D3 */
        , <4 0 &gpio0 4 0>          /* D4 */
        , <5 0 &gpio0 5 0>          /* D5 */
        , <6 0 &gpio1 11 0>         /* D6 */
        , <7 0 &gpio1 12 0>         /* D7 */
        , <8 0 &gpio1 13 0>         /* D8 */
        , <9 0 &gpio1 14 0>         /* D9 */
        , <10 0 &gpio1 15 0>        /* D10 */
        , <11 0 &gpio0 15 0>        /* extra pad, P0.15 */
        , <12 0 &gpio0 19 0>        /* extra pad, P0.19 */
        , <13 0 &gpio1 1 0>         /* extra pad, P1.01 */
        , <14 0 &gpio0 9 0>         /* extra pad, P0.09 -- NFC1 */
        , <15 0 &gpio0 10 0>        /* extra pad, P0.10 -- NFC2 */
        , <16 0 &gpio0 31 0>        /* extra pad, P0.31 */
        , <17 0 &gpio1 7 0>         /* extra pad, P1.07 -- Zenith column */
        , <18 0 &gpio1 5 0>         /* extra pad, P1.05 -- Zenith column */
        , <19 0 &gpio1 3 0>         /* extra pad, P1.03 -- Zenith column */
        ;
};
